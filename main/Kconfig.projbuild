## main/Kconfig.projbuild
```kconfig
menu "Application Configuration"

	config GPIO_RANGE_MAX
		int
		default 33 if IDF_TARGET_ESP32
		default 46 if IDF_TARGET_ESP32S2
		default 48 if IDF_TARGET_ESP32S3
		default 18 if IDF_TARGET_ESP32C2
		default 19 if IDF_TARGET_ESP32C3
		default 30 if IDF_TARGET_ESP32C6

	menu "WiFi Setting"

		config ESP_WIFI_SSID
			string "WiFi SSID"
			default "myssid"
			help
				SSID (network name) for the example to connect to.

		config ESP_WIFI_PASSWORD
			string "WiFi Password"
			default "mypassword"
			help
				WiFi password (WPA or WPA2) for the example to use.

		config ESP_MAXIMUM_RETRY
			int "Maximum retry"
			default 5
			help
				Set the Maximum retry to avoid station reconnecting to the AP unlimited when the AP is really inexistent.

		config MDNS_HOSTNAME
			string "mDNS hostname"
			default "esp32"
			help
				mDNS hostname

	endmenu

	menu "UART Setting"

		config UART_TX_GPIO
			int "UART TX GPIO number"
			range 0 GPIO_RANGE_MAX
			default 17 if IDF_TARGET_ESP32
			default  2 if IDF_TARGET_ESP32S2 || IDF_TARGET_ESP32S3
			default  1 # C3 and others
			help
				GPIO number (IOxx) to UART TX.

		config UART_RX_GPIO
			int "UART RX GPIO number"
			range 0 GPIO_RANGE_MAX
			default 16 if IDF_TARGET_ESP32
			default  1 if IDF_TARGET_ESP32S2 || IDF_TARGET_ESP32S3
			default  0 # C3 and others
			help
				GPIO number (IOxx) to UART RX.

		config UART_BAUD_RATE
			int "UART communication speed"
			range 1200 115200
			default 115200
			help
				UART communication speed.

	endmenu

	menu "Broker Setting"

		choice MQTT_TRANSPORT
			prompt "MQTT Transport"
			default MQTT_TRANSPORT_OVER_TCP
			help
				Select MQTT Transport.
			config MQTT_TRANSPORT_OVER_TCP
				bool "Using Over TCP"
				help
					Using Over TCP
			config MQTT_TRANSPORT_OVER_SSL
				bool "Using over SSL"
				help
					Using over SSL
			config MQTT_TRANSPORT_OVER_WS
				bool "Using over WS"
				help
					Using over WS
			config MQTT_TRANSPORT_OVER_WSS
				bool "Using over WSS"
				help
					Using over WSS
		endchoice

		config MQTT_BROKER
			string "MQTT Broker"
			default "broker.emqx.io"
			help
				Host name or IP address of the broker to connect to

		config MQTT_PORT_TCP
			depends on MQTT_TRANSPORT_OVER_TCP
			int "MQTT Port"
			range 0 65535
			default 1883
			help
				Port number of the broker to connect to.

		config MQTT_PORT_SSL
			depends on MQTT_TRANSPORT_OVER_SSL
			int "MQTT Port"
			range 0 65535
			default 8883
			help
				Port number of the broker to connect to.

		config MQTT_PORT_WS
			depends on MQTT_TRANSPORT_OVER_WS
			int "MQTT Port"
			range 0 65535
			default 8083
			help
				Port number of the broker to connect to.

		config MQTT_PORT_WSS
			depends on MQTT_TRANSPORT_OVER_WSS
			int "MQTT Port"
			range 0 65535
			default 8084
			help
				Port number of the broker to connect to.

		choice MQTT_PROTOCOL
			prompt "MQTT Protocol"
			default MQTT_PROTOCOL_V_3_1_1
			help
				Select Protocol.
			config MQTT_PROTOCOL_V_3_1_1
				bool "PROTOCOL_V_3_1_1"
				help
					PROTOCOL_V_3_1_1
			config MQTT_PROTOCOL_V_5
				bool "PROTOCOL_V_5"
				help
					PROTOCOL_V_5.
		endchoice

		config MQTT_SUB_TOPIC
			string "Subscribe Topic"
			default "/topic/uart/rx"
			help
				Topic of subscribe

		config MQTT_PUB_TOPIC
			string "Publish Topic"
			default "/topic/uart/tx"
			help
				Topic of publish

		config BROKER_AUTHENTICATION
			bool "Server requests for password when connecting"
			default false
			help
				Server requests for password when connecting.

		config AUTHENTICATION_USERNAME
			depends on BROKER_AUTHENTICATION
			string "Username used for connecting to the broker"
			default "user"
			help
				Username used for connecting to the broker.

		config AUTHENTICATION_PASSWORD
			depends on BROKER_AUTHENTICATION
			string "Password used for connecting to the broker"
			default "password"
			help
				Username used for connecting to the broker.

	endmenu

endmenu
```
